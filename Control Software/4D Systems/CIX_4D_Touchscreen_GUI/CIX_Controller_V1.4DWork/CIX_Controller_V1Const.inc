// File generated 12/9/2023 12:13:35 PM
// Warning! This is a generated file, any manual changes will be
// lost during the next generation.

#constant  Strings1Count    0
#constant  Strings1Size     1
#constant  Strings2Count    0
#constant  Strings2Size     1
#constant  Strings3Count    0
#constant  Strings3Size     1
#constant  Strings4Count    0
#constant  Strings4Size     1
#constant  Strings5Count    0
#constant  Strings5Size     1
#constant  Strings6Count    0
#constant  Strings6Size     1
#DATA
    byte iKeyboard0keystrokes 0x90, 0x6F, 0x6A, 0x6D, 0x37, 0x38, 0x39, 0x6B, 0x34, 0x35, 0x36, 0x31, 0x32, 0x33, 0x0D, 0x30, 0x6E
#END


#constant  IFONT_OFFSET     0
// object indexes into ImageControl
#CONST
    i4Dbutton0      // offset 0x0
    i4Dbutton1      // offset 0x8200
    iImage0         // offset 0xCC00
    iStatictext0    // offset 0x19A00
    iStatictext1    // offset 0x1A600
    iStatictext2    // offset 0x1B200
    iStatictext3    // offset 0x1BE00
    iStatictext4    // offset 0x1CC00
    i4Dbutton3      // offset 0x1E200
    iUserled0       // offset 0x22400
    iStatictext5    // offset 0x22E00
    i4Dbutton2      // offset 0x23A00
    iStatictext6    // offset 0x27C00
    iUserled1       // offset 0x28600
    iLed0           // offset 0x29000
    iLed1           // offset 0x2BC00
    iLed2           // offset 0x2E800
    iLed3           // offset 0x31400
    iLed4           // offset 0x34600
    iLed5           // offset 0x37E00
    iLed6           // offset 0x3B600
    iLed7           // offset 0x3E600
    iLed8           // offset 0x41600
    iRotaryswitch0  // offset 0x44600
    iStatictext8    // offset 0xEBA00
    iLed9           // offset 0xECC00
    iStatictext9    // offset 0xEFC00
    iStatictext10   // offset 0xF2400
    iStatictext11   // offset 0xF4400
    iStatictext12   // offset 0xF5000
    iStatictext13   // offset 0xF5400
    iLed10          // offset 0xF6800
    iKeyboard0      // offset 0xF9800
    iKeyboard0_0    // offset 0x11D800
    iKeyboard0_1    // offset 0x121200
    iKeyboard0_2    // offset 0x124C00
    iKeyboard0_3    // offset 0x128600
    iKeyboard0_4    // offset 0x12C000
    iKeyboard0_5    // offset 0x12FA00
    iKeyboard0_6    // offset 0x133400
    iKeyboard0_7    // offset 0x136E00
    iKeyboard0_8    // offset 0x13E000
    iKeyboard0_9    // offset 0x141A00
    iKeyboard0_10   // offset 0x145400
    iKeyboard0_11   // offset 0x148E00
    iKeyboard0_12   // offset 0x14C800
    iKeyboard0_13   // offset 0x150200
    iKeyboard0_14   // offset 0x153C00
    iKeyboard0_15   // offset 0x15AE00
    iKeyboard0_16   // offset 0x161E00
    iStatictext7    // offset 0x165800
#END

#constant  Strings0Size     0
#constant  Strings0StartH   0
#constant  Strings0StartL   0

#constant  Strings1StartH   0x0
#constant  Strings1StartL   0x0
#constant  Strings2StartH   0x0
#constant  Strings2StartL   0x200
#constant  Strings3StartH   0x0
#constant  Strings3StartL   0x400
#constant  Strings4StartH   0x0
#constant  Strings4StartL   0x600
#constant  Strings5StartH   0x0
#constant  Strings5StartL   0x800
#constant  Strings6StartH   0x0
#constant  Strings6StartL   0xA00

#IFNOT EXISTS NOGLOBALS
var hndl ;
var hFonts[7] ;
var oKeyboard0[12] := [-1, 0, 0, 0, 0, 255, 255, 255, 255, 255, 17, 0] ;
#ENDIF
